
#include "nci_utils.h"
#include "FreeRTOS.h"
#include "task.h"
#include "semphr.h"
#include "port.h"
#include <phOsalNfc.h>
#include <phOsalNfc_Thread.h>
#include <phOsalNfc_Log.h>
#include "debug_settings.h"
#include "wearable_platform_int.h"
#include "wearable_tlv_types.h"
#include "phNxpNciHal.h"
#include <eaci_uart.h>
#include "lpc_res_mgr.h"
#include "fp_handler.h"
#include "fp.h"
#include "lpc_lowpower_timer.h"

//#define DEBUG_USE_TEST_TEMPLATE


// Data received from PN80T
static uint8_t fpPN80T_Data[265]; // APDU_SIZE
static uint16_t fpPN80T_DataSize = 255;

// Data received from MCU2
uint16_t fpMcu_DataSize;			// Template size
uint8_t *p_fpMcu_Data;				// Template data

// Debug variables for timing measurements
uint32_t timer_start, timer_stop, timer_diff;


static const unsigned char VER_TEMPLATE[485] = {
		0x7F, 0x2E, 0x82, 0x01, 0xE0, 0xA1, 0x28, 0x81, 0x1E, 0x4A,
		0x29, 0x6C, 0x0F, 0x47, 0x74, 0x13, 0x07, 0x8B, 0x34, 0x34,
		0x8D, 0x4B, 0x04, 0xAA, 0x1D, 0x4F, 0xB7, 0x2D, 0x48, 0x58,
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		0x65, 0xC5, 0x02, 0x00, 0x00,
};

static const unsigned char ENR_TEMPLATE[7864] = {
		0xEF, 0x82, 0x1E, 0xB4, 0xC0, 0x02, 0x83, 0x04, 0xEE, 0x82,
		0x01, 0xE5, 0x7F, 0x2E, 0x82, 0x01, 0xE0, 0xA1, 0x28, 0x81,
		0x1E, 0x4A, 0x29, 0x6C, 0x0F, 0x47, 0x74, 0x13, 0x07, 0x8B,
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		0xC5, 0x02, 0x00, 0x00,

};

/*******************************************************************************
**
** Function:    phNfcFp_PerformEnrollment()
**
** Description: Performs  Finger Print enrollment specific operations
**
** Parameters:  None
**
** Returns:     tFP_STATUS
**
*******************************************************************************/
tFP_STATUS phNfcFp_PerformEnrollment(void)
{
	//phNfcFp_Context_t * pFpContext = (phNfcFp_Context_t *)pContext;
	tFP_STATUS ret = STATUS_FAILED;
	uint32_t tempLen;
	//uint8_t rsp_operation = eOperation_None;

	phOsalNfc_Log("phNfcFp_PerformEnrollment\n", ret);

#ifndef DEBUG_BYPASS_PN80T
	// Retrieve Matcher configuration from PN80T
	ret = fpPNx_Matcher_SendData(0, NULL, &fpPN80T_DataSize, fpPN80T_Data);
	if(ret != STATUS_OK) {
		phOsalNfc_Log("PN80T Send Data Error: %d\n", ret);
		return ret;
	}

	phOsalNfc_Log("Select APDU Response size: %d\n", fpPN80T_DataSize);
#else
	fpPN80T_DataSize = sizeof(SELECT_APDU_RESP);
	memcpy(fpPN80T_Data, SELECT_APDU_RESP, fpPN80T_DataSize);
#endif

#ifndef DEBUG_USE_TEST_TEMPLATE
	p_fpMcu_Data = fp_template_get(&tempLen);
	fpMcu_DataSize = tempLen & 0xFFFF;
	DEBUGOUT("The template addr:0x%x, size:%d\r\n", p_fpMcu_Data, fpMcu_DataSize);
#else
	fpMcu_DataSize = sizeof(ENR_TEMPLATE);

	p_fpMcu_Data = (uint8_t*) malloc(fpMcu_DataSize);
	memcpy(p_fpMcu_Data, ENR_TEMPLATE, fpMcu_DataSize);
#endif

#ifndef DEBUG_BYPASS_PN80T
#if 1
	// Send template data to Matcher applet
	ret = fpPNx_Matcher_SendData(fpMcu_DataSize, p_fpMcu_Data, &fpPN80T_DataSize, fpPN80T_Data);
	if(ret != STATUS_OK) {
		phOsalNfc_Log("PN80T Send Data Error: %d\n", ret);
		return ret;
	}

	// Provide UI feedback
	if((fpPN80T_Data[fpPN80T_DataSize-2] == 0x90) && (fpPN80T_Data[fpPN80T_DataSize-1] == 0x00)) {
		//ret = ui_update(true, eOperation_StartEnrollment, STATUS_OK, fpPN80T_DataSize, fpPN80T_Data);
		DEBUGOUT("PN80T Enrollment OK.\r\n");
	} else {
		//ret = ui_update(true, eOperation_StartEnrollment, STATUS_ENROLLMENT_FAILED, fpPN80T_DataSize, fpPN80T_Data);
		DEBUGOUT("PN80T Enrollment fail.\r\n");
	}
#endif
#endif

	return STATUS_OK;
}


#if 1

/*******************************************************************************
**
** Function:    phNfcFp_PerformMatching()
**
** Description: Performs  Stops enrollment operations to release resources on MCU2
**
** Parameters:  None
**
** Returns:     tFP_STATUS
**
*******************************************************************************/
tFP_STATUS phNfcFp_PerformMatching(void)
{
	//phNfcFp_Context_t * pFpContext = (phNfcFp_Context_t *)pContext;
	tFP_STATUS ret = STATUS_FAILED;
    uint32_t tempLen;
    int i;
	//uint8_t rsp_operation = eOperation_None;

#ifndef DEBUG_BYPASS_PN80T
	// Retrieve Matcher configuration from PN80T
	ret = fpPNx_Matcher_SendData(0, NULL, &fpPN80T_DataSize, fpPN80T_Data);
	if(ret != STATUS_OK) {
		phOsalNfc_Log("PN80T Send Data Error: %d\n", ret);
		return ret;
	}
    
    DEBUGOUT("Match config data. size:%d\r\n", fpPN80T_DataSize);
    uint8_t *p = fpPN80T_Data;
    for(i = 0; i < fpPN80T_DataSize; i=i+8) {
	    DEBUGOUT("%02x %02x %02x %02x %02x %02x %02x %02x\r\n",
		      p[i], p[i+1], p[i+2], p[i+3], p[i+4], p[i+5], p[i+6], p[i+7]);
	}

#else
	fpPN80T_DataSize = sizeof(SELECT_APDU_RESP);
	memcpy(fpPN80T_Data, SELECT_APDU_RESP, fpPN80T_DataSize);
#endif

#ifndef DEBUG_USE_TEST_TEMPLATE
	p_fpMcu_Data = fp_match_feature_get(&tempLen);
	fpMcu_DataSize = tempLen & 0xFFFF;
	DEBUGOUT("The template addr:0x%x, size:%d\r\n", p_fpMcu_Data, fpMcu_DataSize);
#else
	fpMcu_DataSize = sizeof(VER_TEMPLATE);

	p_fpMcu_Data = (uint8_t*) malloc(fpMcu_DataSize);
	memcpy(p_fpMcu_Data, VER_TEMPLATE, fpMcu_DataSize);
#endif

#ifndef DEBUG_BYPASS_PN80T
	// Send template data to Matcher applet
	timer_start = getTimeMsec();
	ret = fpPNx_Matcher_SendData(fpMcu_DataSize, p_fpMcu_Data, &fpPN80T_DataSize, fpPN80T_Data);
	timer_stop = getTimeMsec();
	if(ret != STATUS_OK) {
		phOsalNfc_Log("PN80T Send Data Error: %d\n", ret);
		return ret;
	}

	// Calculate the time for matching
	timer_diff = getTimeDiffMsec(timer_stop, timer_start);

	printf("Matching time: %lu\n", timer_diff);

	// Provide UI feedback
	if((fpPN80T_Data[fpPN80T_DataSize-2] == 0x90) && (fpPN80T_Data[fpPN80T_DataSize-1] == 0x00)) {
		DEBUGOUT("Match OK.\r\n");
	} else {
		DEBUGOUT("Match Fail.\r\n");
        DEBUGOUT("Match result data. size:%d\r\n", fpPN80T_DataSize);
        p = fpPN80T_Data;
        for(i = 0; i < fpPN80T_DataSize; i=i+8) {
            DEBUGOUT("%02x %02x %02x %02x %02x %02x %02x %02x\r\n",
                  p[i], p[i+1], p[i+2], p[i+3], p[i+4], p[i+5], p[i+6], p[i+7]);
        }
	}

#endif

	return STATUS_OK;
}
#endif


/*******************************************************************************
**
** Function:    phNfcFp_PerformDeleteFinger()
**
** Description: Performs  Deletes enrolled finger
**
** Parameters:  None
**
** Returns:     tFP_STATUS
**
*******************************************************************************/
static uint8_t fpDeleteFinger[] = {0xEF, 0x04, 0xc0, 0x02, 0x00, 0x03};
static uint8_t fpDeleteFinger_Size = 6;
tFP_STATUS phNfcFp_PerformDeleteFinger()
{
	tFP_STATUS ret = STATUS_FAILED;
    uint32_t tempLen;

	// For the WS we will always use the same fingerprint id value
	// Finger ID is indicated in the fifth position of this array
	fpDeleteFinger[4] = 0x01;

	// Send template data to Matcher applet
	ret = fpPNx_Matcher_SendData(fpDeleteFinger_Size, fpDeleteFinger, &fpPN80T_DataSize, fpPN80T_Data);
	if(ret != STATUS_OK) {
		phOsalNfc_Log("PN80T Send Data Error: %d\n", ret);
		return ret;
	}
    
    #if 0
    p_fpMcu_Data = fp_match_feature_get(&tempLen);
	fpMcu_DataSize = tempLen & 0xFFFF;
	DEBUGOUT("The template addr:0x%x, size:%d\r\n", p_fpMcu_Data, fpMcu_DataSize);
    
    ret = fpPNx_Matcher_SendVerifiedCmd(fpMcu_DataSize, p_fpMcu_Data, fpDeleteFinger_Size, fpDeleteFinger, &fpPN80T_DataSize, fpPN80T_Data);
	if(ret != STATUS_OK) {
		phOsalNfc_Log("PN80T Send Data Error: %d\n", ret);
		return ret;
	}
    #endif

	// Provide UI feedback
	if((fpPN80T_Data[fpPN80T_DataSize-2] == 0x90) && (fpPN80T_Data[fpPN80T_DataSize-1] == 0x00)) {
		DEBUGOUT("Delete FP SUCC.\r\n");
	} else {
		DEBUGOUT("Delete FP FAIL.\r\n");
	}

	return STATUS_OK;
}

/*******************************************************************************
**
** Function:    phNfcFp_PerformGetData()
**
** Description: Performs  Deletes enrolled finger
**
** Parameters:  None
**
** Returns:     tFP_STATUS
**
*******************************************************************************/
static uint8_t fpGetData[] = {0x80, 0xCA, 0x00, 0xD3, 0x00};//{0x80, 0xCA, 0x00, 0xD2, 0x00};
static uint8_t fpGetData_Size = 5;
tFP_STATUS phNfcFp_PerformGetData()
{
	tFP_STATUS ret = STATUS_FAILED;
    uint32_t tempLen;
    int i;

	// Send template data to Matcher applet
	ret = fpPNx_Matcher_SendRawData(fpGetData_Size, fpGetData, &fpPN80T_DataSize, fpPN80T_Data);
	if(ret != STATUS_OK) {
		phOsalNfc_Log("PN80T Send Data Error: %d\n", ret);
		return ret;
	}
    

	// Provide UI feedback
	if((fpPN80T_Data[fpPN80T_DataSize-2] == 0x90) && (fpPN80T_Data[fpPN80T_DataSize-1] == 0x00)) {
		DEBUGOUT("Get data SUCC.\r\n");
        for(i = 0; i < fpPN80T_DataSize; i++) {
            DEBUGOUT("%02x ", fpPN80T_Data[i]);
        }
        DEBUGOUT("\r\n\r\n");
	} else {
		DEBUGOUT("Get Data Fail.\r\n");
        for(i = 0; i < fpPN80T_DataSize; i++) {
            DEBUGOUT("%02x ", fpPN80T_Data[i]);
        }
        DEBUGOUT("\r\n\r\n");
	}

	return STATUS_OK;
}